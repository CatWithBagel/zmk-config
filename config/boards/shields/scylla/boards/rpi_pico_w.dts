#include "rpi_pico_w-pinctrl.dtsi"

&pio0 {
    /* enables this PIO block */
    status = "okay";
    pio0_spi: pio0_spi {
        /* Assign pinctrl to node */
        pinctrl-0 = <&pio0_spi_default>;
        pinctrl-names = "default";
        compatible = "raspberrypi,pico-spi-pio";
        #address-cells = <1>;
        #size-cells = <0>;
        clocks = <&system_clk>;
        clock-frequency = <4000000>;
        /* These pins should be the same as in pinctrl */
        miso-gpios = <&gpio0 12 0>;
        clk-gpios = <&gpio0 14 GPIO_ACTIVE_HIGH>;
        mosi-gpios = <&gpio0 15 GPIO_ACTIVE_HIGH>;

        cs-gpios = <...>; // List of chip select gpios, one for each device
        /* Nodes using the bus go here */
    };
};
